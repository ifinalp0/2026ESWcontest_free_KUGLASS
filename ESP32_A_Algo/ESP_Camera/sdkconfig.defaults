## ESP32_Algo/sdkconfig.defaults
```kconfig
CONFIG_IDF_TARGET="esp32s3"
CONFIG_IDF_TARGET_ESP32S3=y
CONFIG_ESP_CONSOLE_USB_CDC=y
CONFIG_ESP_CONSOLE_UART_DEFAULT=n
CONFIG_FREERTOS_HZ=1000
CONFIG_COMPILER_CXX_EXCEPTIONS=n
CONFIG_COMPILER_CXX_RTTI=n
```

## ESP_Camera/main/Kconfig.projbuild
```kconfig
menu "OV2640 camera application"

    config CAMERA_APP_SERIAL_BAUD
        int "USB-to-UART frame baud rate"
        range 115200 2000000
        default 2000000
        help
            Baud rate used after camera initialization to transmit RGB565
            camera frames as software-encoded JPEG through the DevKitC
            USB-to-UART bridge.

    config CAMERA_APP_JPEG_QUALITY
        int "Software JPEG quality"
        range 1 100
        default 85
        help
            Quality passed to the esp32-camera software JPEG encoder.
            Higher values preserve more detail but produce larger frames.

endmenu
```

## For_Test/ESP32_B_TEST/sdkconfig.defaults
```kconfig
CONFIG_IDF_TARGET="esp32s3"
CONFIG_IDF_TARGET_ESP32S3=y
CONFIG_ESP_DEFAULT_CPU_FREQ_MHZ_240=y
CONFIG_FREERTOS_HZ=1000
CONFIG_ESP_MAIN_TASK_STACK_SIZE=8192
CONFIG_COMPILER_CXX_EXCEPTIONS=n
CONFIG_COMPILER_CXX_RTTI=n
CONFIG_BOOTLOADER_LOG_LEVEL_NONE=y
CONFIG_ESP_CONSOLE_NONE=y
CONFIG_ESP_CONSOLE_SECONDARY_NONE=y
CONFIG_ESP_CONSOLE_UART_DEFAULT=n
CONFIG_USJ_ENABLE_USB_SERIAL_JTAG=n
CONFIG_GPIO_CTRL_FUNC_IN_IRAM=y
CONFIG_ESP_TASK_WDT_EN=y
CONFIG_ESP_TASK_WDT_INIT=y
CONFIG_ESP_TASK_WDT_PANIC=y
CONFIG_ESP_TASK_WDT_TIMEOUT_S=1
```
